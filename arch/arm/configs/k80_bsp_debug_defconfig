## arch/arm/mach-mediatek/Kconfig
```kconfig
menuconfig ARCH_MEDIATEK
	bool "MediaTek SoC Support"
	depends on ARCH_MULTI_V7
	select ARM_GIC
	select PINCTRL
	select MTK_TIMER
	select MFD_SYSCON
	help
	  Support for Mediatek MT65xx & MT81xx SoCs

if ARCH_MEDIATEK

config MACH_MT2701
	bool "MediaTek MT2701 SoCs support"

config MACH_MT6589
	bool "MediaTek MT6589 SoCs support"

config MACH_MT6592
	bool "MediaTek MT6592 SoCs support"

config MACH_MT7623
	bool "MediaTek MT7623 SoCs support"

config MACH_MT7629
	bool "MediaTek MT7629 SoCs support"

config MACH_MT8127
	bool "MediaTek MT8127 SoCs support"

config MACH_MT8135
	bool "MediaTek MT8135 SoCs support"

endif

config MACH_MT6735
	bool "MediaTek MT6735"
	select GENERIC_TIME
	select GENERIC_CLOCKEVENTS
	select ARCH_HAS_CPUFREQ
	select ARM_HAS_SG_CHAIN
	select ARM_AMBA
	select CPU_V7
	select HAVE_SMP
	select IRQ_DOMAIN
	select IRQ_DOMAIN_DEBUG
	select GENERIC_SCHED_CLOCK
	select VFP_OPT
	select ARCH_REQUIRE_GPIOLIB
	select MTK_SYS_CIRQ
	select MTK_EIC
	select MTK_GPIO
	select MTK_IRQ
	select COMMON_CLK if !MTK_CLKMGR
	select CPU_IDLE
	select PINCTRL
	select PINCTRL_MT6735
	select MFD_SYSCON
	select MTK_BASE_POWER
        select VFP
	select VFPv3
	select NEON
	select KERNEL_MODE_NEON
	select ARM_CRYPTO
	select CRYPTO_AES_ARM_CE
	select CRYPTO_SHA2_ARM_CE
	select ARM_ERRATA_836870
	select MTK_IRQ_NEW_DESIGN
	select MTK_IRQ_NEW_DESIGN_DEBUG
	select MTK_POWER_GS
	select MTK_CPU_STRESS
	select SDCARD_FS
	select OVERLAY_FS
	select MTK_DEVINFO_DRIVER
	select MTK_DRAMC_LEGACY
	select MTK_EMI_BWL
	select MTK_EMI_MPU
	help
	  This enable support for MediaTek MT6735

config MACH_MT6735M
	bool "MediaTek MT6735M"
	select GENERIC_TIME
	select GENERIC_CLOCKEVENTS
	select ARCH_HAS_CPUFREQ
	select ARM_AMBA
	select CPU_V7
	select HAVE_SMP
	select IRQ_DOMAIN
	select IRQ_DOMAIN_DEBUG
	select GENERIC_SCHED_CLOCK
	select VFP_OPT
	select ARCH_REQUIRE_GPIOLIB
	select MTK_SYS_CIRQ
	select MTK_EIC
	select MTK_GPIO
	select MTK_IRQ
	select ARM_HAS_SG_CHAIN
	select PINCTRL
	select PINCTRL_MT6735
	select MFD_SYSCON
	select CPU_IDLE
	select ARM_MT6735_CPUIDLE
        select VFP
	select VFPv3
	select NEON
	select MTK_BASE_POWER
	select KERNEL_MODE_NEON
	select ARM_CRYPTO
	select CRYPTO_AES_ARM_CE
	select CRYPTO_SHA2_ARM_CE
	select ARM_ERRATA_836870
	select MTK_IRQ_NEW_DESIGN
	select MTK_POWER_GS
	select MTK_CPU_STRESS
	select HW_RANDOM
	select HW_RANDOM_MT67XX
	select SDCARD_FS
	select OVERLAY_FS
	select MTK_DEVINFO_DRIVER
	select MTK_DRAMC_LEGACY
	select MTK_EMI_BWL
	select MTK_EMI_MPU
	help
	  This enables support for MediaTek MT6735M
	  Support for k35mv1
	  Support for k35mv1_op01
	  Support for k35mv1_op02

config MACH_MT6761
	bool "MediaTek MT6761"
	select GENERIC_TIME
	select GENERIC_CLOCKEVENTS
	select ARCH_HAS_CPUFREQ
	select ARM_AMBA
	select CPU_V7
	select HAVE_SMP
	select IRQ_DOMAIN
	select IRQ_DOMAIN_DEBUG
	select GENERIC_SCHED_CLOCK
	select ARMV7_COMPAT
	select ARMV7_COMPAT_CPUINFO
	select CPU_IDLE
	select PINCTRL
	select MFD_SYSCON
	select VFP
	select VFPv3
	select CPU_V7
	select NEON
	select AEABI
	select KERNEL_MODE_NEON
	select MTK_BASE_POWER
	select MTK_GIC_V3_EXT
	select MTK_SYSIRQ
	select MTK_TIMER
	select MTK_TIMER_TIMESYNC
	select ARM_GIC_V3
	select POWER_SUPPLY
	select MTK_EMI_LEGACY
	select MTK_DRAMC_LEGACY
	select PM_DEVFREQ
	select MTK_SYS_CIRQ
	select ARM_ERRATA_855873
	select MTK_GIC_TARGET_ALL
	select FAST_CIRQ_CLONE_FLUSH
	select MTK_FIQ_CACHE
	select MTK_DEBUG_LATCH
	select MTK_DFD_INTERNAL_DUMP
	select MTK_PLAT_SRAM_FLAG
	select MTK_L2C_PARITY_CHECK
	select MTK_SYSTRACKER_V2
	select MTK_SECURITY_SW_SUPPORT
	select MTK_BOUNCING_CHECK if MTK_AEE_FEATURE
	select ARM_CRYPTO
	select CRYPTO_SHA2_ARM_CE
	select CRYPTO_AES_ARM_CE
	select MTK_PMQOS
	help
	  This enables support for MediaTek MT6761
	  Highly power-efficient, performance-oriented 4G LTE processor
	  for premium, thin-design smartphones. MT6761 also offers significant
	  multitasking and multimedia improvements.

config MACH_MT6765
	bool "MediaTek MT6765"
	select GENERIC_TIME
	select GENERIC_CLOCKEVENTS
	select ARCH_HAS_CPUFREQ
	select ARM_AMBA
	select CPU_V7
	select HAVE_SMP
	select IRQ_DOMAIN
	select IRQ_DOMAIN_DEBUG
	select GENERIC_SCHED_CLOCK
	select ARMV7_COMPAT
	select ARMV7_COMPAT_CPUINFO
	select CPU_IDLE
	select PINCTRL
	select MFD_SYSCON
	select VFP
	select VFPv3
	select CPU_V7
	select NEON
	select AEABI
	select KERNEL_MODE_NEON
	select MTK_GIC_V3_EXT
	select MTK_SYSIRQ
	select MTK_TIMER
	select MTK_TIMER_TIMESYNC
	select ARM_GIC_V3
	select POWER_SUPPLY
	select MTK_EMI_LEGACY
	select MTK_DRAMC_LEGACY
	select PM_DEVFREQ
	select MTK_SYS_CIRQ
	select ARM_ERRATA_855873
	select MTK_GIC_TARGET_ALL
	select FAST_CIRQ_CLONE_FLUSH
	select MTK_DEBUG_LATCH
	select MTK_DFD_INTERNAL_DUMP
	select MTK_PLAT_SRAM_FLAG
	select MTK_L2C_PARITY_CHECK
	select MTK_SYSTRACKER_V2
	select MTK_BOUNCING_CHECK if MTK_AEE_FEATURE
	select ARM_CRYPTO
	select CRYPTO_SHA2_ARM_CE
	select CRYPTO_AES_ARM_CE
	select MTK_PMQOS
	help
	  This enables support for MediaTek MT6765
	  Highly power-efficient, performance-oriented 4G LTE processor
	  for premium, thin-design smartphones. MT6765 also offers significant
	  multitasking and multimedia improvements.
```

## drivers/input/touchscreen/mediatek/fts_ts/Kconfig
```kconfig
#
# Touchscreen driver configuration
#

config TOUCHSCREEN_MTK_FOCALTECH_TS
	bool "FT5X0X for Mediatek package"
	default n
	help
	  Say Y here if you have FT5X0X touch panel.
	  If unsure, say N.

	  To compile this dirver as a module, choose M here: the
	  module will be called.
```

## drivers/input/touchscreen/mediatek/gslx680/Kconfig
```kconfig
#
# Touchscreen driver configuration
#
config TOUCHSCREEN_MTK_GSLX680
	tristate "GSLX68X for Mediatek package"
	default n
	help
	  Say Y here if you have GSLX68X touch panel.

	  If unsure, say N.

	  To compile this dirver as a module, choose M here: the
	  module will be called.

config GSLX68X_FIRMWARE
	string "GSLX68X for Mediatek firmware"

config GSL3680_CONFIG
	string "GSLX68X for Mediatek config"
```

## drivers/input/touchscreen/mediatek/svbfts_ts/Kconfig
```kconfig
#
# Touchscreen driver configuration
#

config TOUCHSCREEN_MTK_SVB_FOCALTECH_TS
	bool "svbfts_ts for Mediatek package"
	default n
	help
	  Say Y here if you have FTS touch panel.
	  If unsure, say N.
	  
	  If you say Y there you have svbfts_ts touch panel driver.
	  If unsure, say N.

	  To compile this dirver as a module, choose M here: the
	  module will be called.
```

## drivers/input/touchscreen/mediatek/tlsc6x/Kconfig
```kconfig
#
# Touchscreen driver configuration
#
config TOUCHSCREEN_MTK_TLSC6X
	bool "TLSC6X for Mediatek package"
	default n
	help
	  Say Y here if you have TLSC6X touch panel TOUCHSCREEN_MTK_TLSC6X.

	  If unsure, say N.

	  To compile this dirver as a module, choose M here: the
	  module will be called.
    
```

## drivers/misc/mediatek/Kconfig
```kconfig
source "drivers/misc/mediatek/Kconfig.default"
source "drivers/misc/mediatek/uart/Kconfig"

menuconfig MEDIATEK_SOLUTION
	bool "MediaTek Properitary Configuration"
	help
	  Check this to enable MediaTek properity configuration.

if MEDIATEK_SOLUTION
config MTK_PLATFORM
	string "MTK platform name"

config ARCH_MTK_PROJECT
	string "MTK project name"

config MTK_ENG_BUILD
	bool "MTK Engineer Build"
	help
	  This is an option for developers. Say Y here for MTK engineering
	  mode, which will have more debugging features built-in.
	  Please set N for user mode to avoid performance impact.
	  If unsure, say N here.

menu "Storage"
source "drivers/misc/mediatek/blocktag/Kconfig"
endmenu # Storage

endif

source "drivers/misc/mediatek/accdet/Kconfig"
source "drivers/misc/mediatek/boot/Kconfig"
source "drivers/misc/mediatek/boot_reason/Kconfig"
source "drivers/misc/mediatek/chip/Kconfig"
source "drivers/misc/mediatek/mtprof/Kconfig"
source "drivers/misc/mediatek/dramc/Kconfig"
source "drivers/misc/mediatek/gpio/Kconfig"
source "drivers/misc/mediatek/devinfo/Kconfig"
source "drivers/misc/mediatek/rtc/Kconfig"
source "drivers/misc/mediatek/aee/Kconfig"
source "drivers/misc/mediatek/m4u/Kconfig"
source "drivers/misc/mediatek/vibrator/Kconfig"
source "drivers/misc/mediatek/leds/Kconfig"
source "drivers/misc/mediatek/auxadc/Kconfig"
source "drivers/misc/mediatek/monitor_hang/Kconfig"

menu "Power, PMIC, Battery & Low Power related configs"
config MTK_BASE_POWER
	bool "MediaTek power management"
	help
	  For MediaTek power management features, such as CPU idle,
	  CPU suspend, CPU DVFS, GPU DVFS,
	  Select if you want to enable MediaTek power
	  management feature.

config MTK_POWER_GS
	bool "MediaTek power golden setting"
	help
	  For MediaTek power golden setting feature.
	  Select if you want to enable MediaTek power
	  golden setting feature.

config MTK_FREQ_HOPPING
  bool "MediaTek FREQHOPPING SUPPORT"
  help
    If you want to use MediaTek freqhopping, say Y here.If unsure, say N.
	Please choose your desired freqhopping driver as well. E.g: MTK2712_FREQ_HOPPING=y
source "drivers/misc/mediatek/pmic_wrap/Kconfig"
source "drivers/misc/mediatek/power/Kconfig"
source "drivers/misc/mediatek/base/power/Kconfig"
source "drivers/misc/mediatek/freqhopping/Kconfig"
source "drivers/misc/mediatek/thermal/Kconfig"
endmenu  # Power

menu "Other Peripherals"
source "drivers/misc/mediatek/i2c/Kconfig"
source "drivers/misc/mediatek/irq/Kconfig"
source "drivers/misc/mediatek/usb20/Kconfig"
source "drivers/misc/mediatek/usb2jtag/Kconfig"
source "drivers/misc/mediatek/devapc/Kconfig"
source "drivers/misc/mediatek/emi_bwl/Kconfig"
source "drivers/misc/mediatek/emi_mpu/Kconfig"
source "drivers/misc/mediatek/debug_latch/Kconfig"
source "drivers/misc/mediatek/gpu/Kconfig"
source "drivers/misc/mediatek/systracker/Kconfig"

endmenu # Peripheral

menu "MultiMedia, Display, Camera related configs"

config CUSTOM_KERNEL_IMGSENSOR
	string "Custom image sensor driver"
	help
	  Kernel space image sensor driver. Define  project used all image
	  sensors .The value is combination of CUSTOM_KERNEL_MAIN_IMGSENSOR,
	  CUSTOM_KERNEL_MAIN_BACKUP_IMGSENSOR, CUSTOM_KERNEL_SUB_IMGSENSOR,
	  and CUSTOM_KERNEL_SUB_BACKUP_IMGSENSOR

config MTK_SEC_VIDEO_PATH_SUPPORT
	bool "Enable MTK Secure Video Path Support"
	depends on MTK_IN_HOUSE_TEE_SUPPORT || TRUSTONIC_TEE_SUPPORT || TRUSTY
	help
	  This enable MTK Secure Video Path Support. (depending on
	  MTK In-House TEE Support or Trustonic TEE Support)

config MTK_LCM_PHYSICAL_ROTATION_HW
	bool "Rotate LCM display for 180 degree using HW"
	help
	  Rotate LCM display for 180 degree using mediatek hardware engine
	  Enable it when LCM hardware is intalled upside down,
	  and you need to rotate the display content to adapting.

source "drivers/misc/mediatek/m4u/Kconfig"
source "drivers/misc/mediatek/mmp/Kconfig"
source "drivers/misc/mediatek/cmdq/Kconfig"
source "drivers/misc/mediatek/smi/Kconfig"
source "drivers/misc/mediatek/imgsensor/Kconfig"
source "drivers/misc/mediatek/flashlight/Kconfig"
source "drivers/misc/mediatek/flashlight/richtek/Kconfig"
source "drivers/misc/mediatek/lcm/Kconfig"
source "drivers/misc/mediatek/sync/Kconfig"
source "drivers/misc/mediatek/video/Kconfig"
source "drivers/misc/mediatek/videocodec/Kconfig"
source "drivers/misc/mediatek/jpeg/Kconfig"
source "drivers/misc/mediatek/lens/Kconfig"
source "drivers/misc/mediatek/cameraisp/Kconfig"

endmenu  # MM

menu "Sensors"

config MTK_SENSOR_SUPPORT
	bool "MTK SENSOR SUPPORT"
	help
	  Sensor config for sensor feature in project.
	  Please say Y here if you want to support and sensors
	  with mediatek sensor architecture.
	  If unsure, say N.

config MTK_SENSOR_ARCHITECTURE
	string "MTK SENSOR ARCHITECTURE"
	default "dummy"
	help
	  Sensor config for sensor architecture in project.
	  Please set 1.0/2.0/3.0 etc if you want to support sensor
	  with mediatek sensor architecture.
	  If unsure, set dummy.

source "drivers/misc/mediatek/sensors-1.0/Kconfig"
endmenu # Sensors

menu "Modem & Connectivity related configs"

source "drivers/misc/mediatek/ccci_util/Kconfig"
source "drivers/misc/mediatek/ccmni/Kconfig"
source "drivers/misc/mediatek/dual_ccci/Kconfig"
source "drivers/misc/mediatek/connectivity/Kconfig"
source "drivers/misc/mediatek/conn_md/Kconfig"
source "drivers/misc/mediatek/eccci/Kconfig"
source "drivers/misc/mediatek/btif/Kconfig"
source "drivers/misc/mediatek/btcvsd/Kconfig"
source "drivers/misc/mediatek/sched/Kconfig"

endmenu  # CONN

menu "Security"
source "drivers/misc/mediatek/masp/Kconfig"

endmenu # Security

menu "Other Peripherals"

source "drivers/misc/mediatek/pwm/Kconfig"
source "drivers/misc/mediatek/hardwareinfo/Kconfig"
source "drivers/misc/mediatek/nfc/Kconfig"

endmenu # Peripheral

menu "Debug, log, trace"

source "drivers/misc/mediatek/met_drv/Kconfig"
source "drivers/misc/mediatek/mtprintk/Kconfig"
source "drivers/misc/mediatek/fingerprint/Kconfig"
endmenu # Debug
```

## drivers/misc/mediatek/btcvsd/Kconfig
```kconfig
config MTK_BTCVSD
	bool "MTK BT CVSD ARICHITECTURE"
	help
	  If you say Y, enable MTK_BTCVSD.
	  This is for software BTCVSD. This enable
	  the function for transferring/receiving
	  BT encoded data to/from BT firmware.
```

## drivers/misc/mediatek/emi_bwl/Kconfig
```kconfig
config MTK_EMI_BWL
  bool "enable MTK_EMI_BWL"
  default n
  help
    This enable MTK_EMI_BWL
```

## drivers/misc/mediatek/fingerprint/Kconfig
```kconfig
#
#Fingerprint
#

if MTK_FINGERPRINT_SUPPORT

config MICROARRAY_FINGERPRINT
	bool "Microarray Fingerprint"
	default n
	---help---
	Microarray fingerprint Microarray's 121/112/88/64/48 device.
	
config MICROARRAY_TEE_FINGERPRINT
	bool "Microarray Fingerprint"
	default n
	---help---
	Microarray fingerprint Microarray's 121/112/88/64/48 device.	

config CDFINGER_FINGERPRINT
	bool "CDFINGER Fingerprint"
	default n
	---help---
	CDFINGER fingerprint CDFINGER's 121/112/88/64/48 device.
	
config MTK_FINGERPRINT_FPSENSOR_REE
       tristate "FPSENSOR Fingerprint"
       default n
       help
          FPSENSOR Fingerprint	

config MTK_CDFINGER_TEE_V2_FINGERPRINT_SUPPORT
	bool "MTK_CDFINGER_TEE_V2_FINGERPRINT_SUPPORT"
	help
	  If the platform is supported for MTK_FP_SUPPORT, this 
	  configuration should be configured, and the MTK_FP_SUPPORT
	  driver configuration should be configured as well	
	  

if MICROARRAY_FINGERPRINT = ""
config MTK_FINGERPRINT_SELECT
	string "sensor type"
	default "GF318M"
endif

source "drivers/misc/mediatek/fingerprint/silead/Kconfig"

endif
```

## drivers/misc/mediatek/hardwareinfo/Kconfig
```kconfig
config MTK_HARDWAREINFO
        bool "MTK_HARDWAREINFO"
        default n
        help
          This will enable MTK_HARDWAREINFO
          If you say Y, enable MTK_HARDWAREINFO
```

## drivers/misc/mediatek/imgsensor/Kconfig
```kconfig
config MTK_IMGSENSOR
	tristate "MediaTek image sensor support"
	help
	  This is a driver for the MediaTek
	  image sensors.
	  To compile this driver as a module, choose M here: the
	  module will be called imgsensor.

source "drivers/misc/mediatek/imgsensor/src/Kconfig"
```
