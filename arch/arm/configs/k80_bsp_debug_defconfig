## drivers/misc/mediatek/imgsensor/src/Kconfig
```kconfig
config TABLET_PROJECT
	bool TABLET_PROJECT
	depends on MTK_IMGSENSOR
	help
	  Specify whether the current project is tablet project.

config SPECIFY_IMGSENSOR
	bool "Specify image sensor name"
	depends on MTK_IMGSENSOR
	help
	  Specify name of each sensor to prevent obtaining wrong sensor driver
	  with same sensor ID. For example, imx258_mipi_raw and
	  imx258_mipi_mono are of same sensor ID. If not specifying sensor,
	  imx258_mipi_mono may be recognized as imx258_mipi_raw.

config IMGSENSOR_MAIN
	string "Custom main image sensor"
	depends on SPECIFY_IMGSENSOR
	help
	  Specify name of main sensor to prevent obtaining wrong sensor driver
	  with same sensor ID. For example, imx258_mipi_raw and
	  imx258_mipi_mono are of same sensor ID. If not specifying sensor,
	  imx258_mipi_mono may be recognized as imx258_mipi_raw.

config IMGSENSOR_MAIN2
	string "Custom main2 image sensor"
	depends on SPECIFY_IMGSENSOR
	help
	  Specify name of main2 sensor to prevent obtaining wrong sensor driver
	  with same sensor ID. For example, imx258_mipi_raw and
	  imx258_mipi_mono are of same sensor ID. If not specifying sensor,
	  imx258_mipi_mono may be recognized as imx258_mipi_raw.

config IMGSENSOR_SUB
	string "Custom sub image sensor"
	depends on SPECIFY_IMGSENSOR
	help
	  Specify name of sub sensor to prevent obtaining wrong sensor driver
	  with same sensor ID. For example, imx258_mipi_raw and
	  imx258_mipi_mono are of same sensor ID. If not specifying sensor,
	  imx258_mipi_mono may be recognized as imx258_mipi_raw.

config IMGSENSOR_SUB2
	string "Custom sub2 image sensor"
	depends on SPECIFY_IMGSENSOR
	help
	  Specify name of sub2 sensor to prevent obtaining wrong sensor driver
	  with same sensor ID. For example, imx258_mipi_raw and
	  imx258_mipi_mono are of same sensor ID. If not specifying sensor,
	  imx258_mipi_mono may be recognized as imx258_mipi_raw.
source "drivers/misc/mediatek/imgsensor/src/dummy_camera/Kconfig"
```

## drivers/misc/mediatek/imgsensor/src/dummy_camera/Kconfig
```kconfig
config SUNRITEL_DCAM
  bool "dcam support"
  default n
  help
    dcam support.

config DCAM_CAM2
  bool "DCAM_CAM2 image sensor"
  default n
  depends on SUNRITEL_DCAM
  help
    Specify main2 sensor.	
	
config DCAM_CAM3
  bool "DCAM_CAM3 image sensor"
  default n
  depends on SUNRITEL_DCAM
  help
    Specify sub2 sensor.

config DCAM_CAM2_GC0310
  bool "DCAM_CAM2_GC0310 image sensor"
  default n
  depends on DCAM_CAM2
  help
    DCAM_CAM2_GC0310 main2 sensor.
	
config DCAM_CAM2_GC032A
  bool "DCAM_CAM2_GC032A image sensor"
  default n
  depends on DCAM_CAM2
  help
    DCAM_CAM2_GC032A main2 sensor.

config DCAM_CAM3_GC0310
  bool "DCAM_CAM3_GC0310 image sensor"
  default n
  depends on DCAM_CAM3
  help
    DCAM_CAM3_GC0310 sub2 sensor.	
	
config DCAM_CAM2_SP0A08
  bool "DCAM_CAM2_SP0A08 image sensor"
  default n
  depends on DCAM_CAM2
  help
    DCAM_CAM2_GC0310 main2 sensor.

config DCAM_CAM3_SP0A08
  bool "DCAM_CAM3_SP0A08 image sensor"
  default n
  depends on DCAM_CAM3
  help
    DCAM_CAM3_GC0310 sub2 sensor.	
	
config DCAM_CAM2_GC030A
  bool "DCAM_CAM2_GC030A image sensor"
  default n
  depends on DCAM_CAM2
  help
    DCAM_CAM2_GC030A main2 sensor.

config DCAM_CAM3_GC030A
  bool "DCAM_CAM3_GC030A image sensor"
  default n
  depends on DCAM_CAM3
  help
    DCAM_CAM3_GC030A sub2 sensor.	
	
	
```

## drivers/misc/mediatek/nfc/Kconfig
```kconfig
config NFC_CHIP_SUPPORT
	tristate "NFC driver solution - NFC Controller Driver"
	depends on I2C
	select NFC_ST54_SPI
	help
	  STMicroelectronics ST21NFC Near Field Communication controller
	  support. ST21NFC is standalone NFC and ST54 is combined with secure
	  element. If configures to be y, means devices supports NFC
	  functionality. If configures to be n, means devices doesn't support
	  NFC functionality.

config NFC_ST54_SPI
	tristate "NFC driver solution - SPI Controller Driver"
	depends on SPI && NFC_CHIP_SUPPORT
	help
	  STMicroelectronics ST54 Secure Element controller SPI interface
	  support. ST21NFC is standalone NFC and ST54 is combined with
	  secure element. If configures to be y, means devices supports SPI
	  interface to ST54. If configures to be n, means devices doesn't
	  support SPI interface (eSE still usable).

config MTK_NFC_CLKBUF_ENABLE
	bool "Enable clock buffer for NFC"
	help
	  Enable clock buffer from PMIC for NFC.
	  This configuration need to be set if support NFC functionality
	  whether STMicroelectronics solution or not.
	  If NFC solution is not STMicroelectronics,
	  this configuration SHOULD be set.
	  
config NFC_NXP_SUPPORT
	tristate "NFC driver solution - STMicroelectronics pn553 NFC Controller Driver"
	default n
	depends on I2C
	help
	  STMicroelectronics pn553 Near Field Communication controller support.
	  pn553 can support 2UICC mode, and pn553 can support 1UICC + eSE.
	  If configures to be y, means devices supports NFC functionality.
	  If configures to be n, means devices doesn't support NFC functionality.
```

## drivers/misc/mediatek/power/Kconfig
```kconfig
# Power Related
config MTK_PMIC
	bool "MediaTek PMIC driver"
	---help---
	  This selects for MediaTek(R) PMIC driver.
	  It's main chip type and providing power features like auxadc,
	  buck/ldo, interrupt-controller..etc
	  Select y to support MTK PMIC feature.

config MTK_REF_CHARGER
	bool "MediaTek MT6580 reference phone charger driver"
	---help---
	  This selects for MediaTek(R) Charger driver.
	  It's main chip type and providing charger features.
	  Note this charger setting is only for reference phone.
	  Select y to support MTK Ref charger feature.

config MT6580_USE_FCHR_ENB_KEY
       bool "MT6580_USE_FCHR_ENB_KEY"
       default n
       help
         This will enable MT6580_USE_FCHR_ENB_KEY
         If you say Y, enable MT6580_USE_FCHR_ENB_KEY
```

## drivers/misc/mediatek/sensors-1.0/accelerometer/mxc400x-new/Kconfig
```kconfig
config MTK_MXC400X_NEW
	bool "MTK_MXC400X_Q35 for MediaTek package"
	help
	  It support different accelerometer sensor.
	  If this option is set, it will support
	  MTK_MXC400X_Q35 Accelerometer.
```

## drivers/misc/mediatek/sensors-1.0/accelerometer/mxc6655/Kconfig
```kconfig
config MTK_MXC6655
	bool "MTK_MXC6655 for MediaTek package"
	default n
	help
	  The MXC6655 is a highly integrated,
	  low power internal measurement unit
	  that provides precise acceleration
	  measurement.
	  this config will turn on accelerometer feature.
```

## drivers/misc/mediatek/sensors-1.0/accelerometer/stk8baxx-new/Kconfig
```kconfig
config MTK_STK8BAXX_NEW
	bool "MTK_STK8BAXX_NEW for MediaTek package"
	default n
	help
	  It support different accelerometer sensor.
          If this option is set,
	  it will support
          STK8BAXX Accelerometer.
```

## sound/soc/mediatek/Kconfig
```kconfig
config MT_SND_SOC_6570
	bool "MT_SND_SOC_6570"
	default n
	help
	  If you say Y, enable MT_SND_SOC_6570_driver.
	  Must enable this to use medatek audio driver.
	  The default value is n for MT6570.
	  It is recommended not to change this.

config MT_SND_SOC_6580
	bool "MT_SND_SOC_6580"
	default n
	help
	  If you say Y, enable MT_SND_SOC_6580_driver.

config MT_SND_SOC_CODEC
	string "String for Mediatek audio codec"
	help
	  Specify Mediatek audio codec.
	  Say "mt6351" if you have mt6351 audio codec.

config MTK_SPEAKER
	bool "MTK_SPEAKER"
	default n
	help
	  If you say Y, enable MTK_SPEAKER_AMP

config MTK_NXP_TFA9890
	bool "MTK_NXP_TFA9890"
	default n
	help
	  If you say Y, enable MTK_NXP_TFA9890 driver.

config MTK_SPKGPIO_REWORK
	bool "MTK_SPKGPIO_REWORK"
	default n
	help
	  This is only for MTK internal phone only
	  Enable SPKGPIO REWORK check functionality
	  Will choose the correct GPIO for external AMP
	  If you say Y, enable MTK_SPKGPIO_REWORK

config MTK_HP_ANASWITCH
	bool "MTK_HP_ANASWITCH"
	default n
	help
	  This will enable headphone analog switch control
	  for de-pop functionality
	  Only enable this when you have headphone analog switch
	  If you say Y, enable MTK_HP_ANASWITCH

config MTK_BTCVSD_ALSA
	bool "MTK_BTCVSD_ALSA"
	default n
	help
	  If you say Y, enable MTK_BTCVSD_ALSA.

config MTK_SND_SOC_NEW_ARCH
	bool "Support new audio architecture"
	help
	  If you say Y, enable MTK_SND_SOC_NEW_ARCH.
	  Only enable this when you use refactored audio driver architecture.

config MTK_AUDIO_TUNNELING_SUPPORT
	bool "Audio playback through dsp"
	help
	  Only enable this when we have DSP.
	  This makes audio output pass bitstream without any post processing.
	  The decoding process is done in DSP.
          Select Y to enable MTK_AUDIO_TUNNELING_SUPPORT for DSP playback.

config MTK_SND_HYBRID_DRE_SUPPORT
	bool "Audio Hybrid DRE support"
	help
	  If you say Y, enable MTK_SND_HYBRID_DRE_SUPPORT.
	  Only enable this when we have Hybrid DRE feature.
```
