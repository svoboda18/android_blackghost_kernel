/*
 * Generated by MTK SP Drv_CodeGen Version 03.13.6	for MT6580. Copyright MediaTek Inc. (C) 2013.
 * Mon Apr  1 16:14:53 2019
 * Do Not Modify the File.
 */

/********************
 * GPIO USAGE MAPPING DTSI File
****************/

&gpio_usage_mapping {
	GPIO_SIM1_SCLK = <22>;
	GPIO_SIM1_SIO = <23>;
	GPIO_SIM2_SIO = <24>;
	GPIO_SIM2_SCLK = <25>;
};
