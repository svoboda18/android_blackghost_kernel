/*
 * Generated by MTK SP Drv_CodeGen Version 03.13.6	for MT6580. Copyright MediaTek Inc. (C) 2013.
 * Mon Apr  1 16:14:53 2019
 * Do Not Modify the File.
 */

/********************************************
 *ADC DTSI File
********************************************/

&auxadc {
	adc_channel@ {
		compatible = "mediatek,adc_channel";
		mediatek,temperature0 = <0>;
		mediatek,temperature1 = <1>;
		status = "okay";
	};
};
